#include "ssd1306.h"
#include <string.h>
#include <stdlib.h>

#define OLED_CONTROL_BYTE_CMD_STREAM  0x00
#define OLED_CONTROL_BYTE_DATA_STREAM 0x40

// Fuente estándar ASCII 5x8 (Del carácter ' ' al '~')
static const uint8_t font5x8[][5] = {
    {0x00, 0x00, 0x00, 0x00, 0x00}, {0x00, 0x00, 0x5F, 0x00, 0x00}, {0x00, 0x07, 0x00, 0x07, 0x00},
    {0x14, 0x7F, 0x14, 0x7F, 0x14}, {0x24, 0x2A, 0x7F, 0x2A, 0x12}, {0x23, 0x13, 0x08, 0x64, 0x62},
    {0x36, 0x49, 0x55, 0x22, 0x50}, {0x00, 0x05, 0x03, 0x00, 0x00}, {0x00, 0x1C, 0x22, 0x41, 0x00},
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    {0x00, 0x41, 0x36, 0x08, 0x00}, {0x08, 0x08, 0x2A, 0x1C, 0x08}, {0x08, 0x1C, 0x2A, 0x08, 0x08}
};

static esp_err_t ssd1306_send_cmd(ssd1306_t *dev, uint8_t cmd) {
    i2c_cmd_handle_t cmd_handle = i2c_cmd_link_create();
    i2c_master_start(cmd_handle);
    i2c_master_write_byte(cmd_handle, (dev->i2c_addr << 1) | I2C_MASTER_WRITE, true);
    i2c_master_write_byte(cmd_handle, OLED_CONTROL_BYTE_CMD_STREAM, true);
    i2c_master_write_byte(cmd_handle, cmd, true);
    i2c_master_stop(cmd_handle);
    esp_err_t ret = i2c_master_cmd_begin(dev->i2c_port, cmd_handle, 1000 / portTICK_PERIOD_MS);
    i2c_cmd_link_delete(cmd_handle);
    return ret;
}

esp_err_t ssd1306_init(ssd1306_t *dev, i2c_port_t port, uint8_t addr) {
    dev->i2c_port = port;
    dev->i2c_addr = addr;
    ssd1306_clear(dev);

    const uint8_t init_cmds[] = {
        0xAE, 0xD5, 0x80, 0xA8, 0x3F, 0xD3, 0x00, 0x40,
        0x8D, 0x14, 0x20, 0x00, 0xA1, 0xC8, 0xDA, 0x12,
        0x81, 0xCF, 0xD9, 0xF1, 0xDB, 0x40, 0xA4, 0xA6, 0xAF
    };

    for (int i = 0; i < sizeof(init_cmds); i++) {
        esp_err_t err = ssd1306_send_cmd(dev, init_cmds[i]);
        if (err != ESP_OK) return err;
    }
    return ssd1306_update(dev);
}

void ssd1306_clear(ssd1306_t *dev) {
    memset(dev->buffer, 0, sizeof(dev->buffer));
}

void ssd1306_draw_pixel(ssd1306_t *dev, int x, int y, uint8_t color) {
    if (x >= SSD1306_WIDTH || y >= SSD1306_HEIGHT || x < 0 || y < 0) return;
    uint16_t index = x + (y / 8) * SSD1306_WIDTH;
    if (color) {
        dev->buffer[index] |=  (1 << (y % 8));
    } else {
        dev->buffer[index] &= ~(1 << (y % 8));
    }
}

void ssd1306_draw_line(ssd1306_t *dev, int x0, int y0, int x1, int y1, uint8_t color) {
    int dx = abs(x1 - x0), sx = x0 < x1 ? 1 : -1;
    int dy = -abs(y1 - y0), sy = y0 < y1 ? 1 : -1;
    int err = dx + dy, e2;
    for (;;) {
        ssd1306_draw_pixel(dev, x0, y0, color);
        if (x0 == x1 && y0 == y1) break;
        e2 = 2 * err;
        if (e2 >= dy) { err += dy; x0 += sx; }
        if (e2 <= dx) { err += dx; y0 += sy; }
    }
}

void ssd1306_draw_rect(ssd1306_t *dev, int x, int y, int w, int h, uint8_t color) {
    ssd1306_draw_line(dev, x, y, x + w - 1, y, color);
    ssd1306_draw_line(dev, x, y + h - 1, x + w - 1, y + h - 1, color);
    ssd1306_draw_line(dev, x, y, x, y + h - 1, color);
    ssd1306_draw_line(dev, x + w - 1, y, x + w - 1, y + h - 1, color);
}

// ---- NUEVAS FUNCIONES DE TEXTO ----

void ssd1306_draw_char(ssd1306_t *dev, int x, int y, char c, uint8_t color) {
    // Verificar si el carácter está dentro del rango ASCII imprimible (32 a 126)
    if (c < 32 || c > 126) return;
    
    // Obtener el índice en el arreglo de la fuente
    uint8_t font_index = c - 32;

    for (uint8_t i = 0; i < 5; i++) { // La fuente tiene 5 columnas de ancho
        uint8_t line = font5x8[font_index][i];
        for (uint8_t j = 0; j < 8; j++) { // Y 8 filas de alto
            if (line & 0x01) {
                ssd1306_draw_pixel(dev, x + i, y + j, color);
            } else {
                ssd1306_draw_pixel(dev, x + i, y + j, !color); // Dibuja el fondo
            }
            line >>= 1;
        }
    }
}

void ssd1306_draw_string(ssd1306_t *dev, int x, int y, const char *str, uint8_t color) {
    int current_x = x;
    while (*str) {
        // Salto de línea manual
        if (*str == '\n') {
            y += 8; // Bajar 8 píxeles (altura de la fuente)
            current_x = x;
        } else {
            ssd1306_draw_char(dev, current_x, y, *str, color);
            current_x += 6; // Avanzar 5 píxeles de la letra + 1 píxel de espacio
        }
        str++;
    }
}

// -----------------------------------

esp_err_t ssd1306_update(ssd1306_t *dev) {
    ssd1306_send_cmd(dev, 0x21);
    ssd1306_send_cmd(dev, 0);
    ssd1306_send_cmd(dev, SSD1306_WIDTH - 1);
    
    ssd1306_send_cmd(dev, 0x22);
    ssd1306_send_cmd(dev, 0);
    ssd1306_send_cmd(dev, (SSD1306_HEIGHT / 8) - 1);

    i2c_cmd_handle_t cmd_handle = i2c_cmd_link_create();
    i2c_master_start(cmd_handle);
    i2c_master_write_byte(cmd_handle, (dev->i2c_addr << 1) | I2C_MASTER_WRITE, true);
    i2c_master_write_byte(cmd_handle, OLED_CONTROL_BYTE_DATA_STREAM, true);
    i2c_master_write(cmd_handle, dev->buffer, sizeof(dev->buffer), true);
    i2c_master_stop(cmd_handle);
    
    esp_err_t ret = i2c_master_cmd_begin(dev->i2c_port, cmd_handle, 1000 / portTICK_PERIOD_MS);
    i2c_cmd_link_delete(cmd_handle);
    return ret;
}